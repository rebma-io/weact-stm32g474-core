## Kconfig.weact_stm32g474_core
```kconfig
# Copyright (c) 2024 Christopher Petrilli
#
# SPDX-License-Identifier: MIT

config BOARD_WEACT_STM32G474_CORE
	select SOC_STM32G474XX
```

## Kconfig.weact_stm32g474_long
```kconfig
# Copyright (c) 2024 Christopher Petrilli
#
# SPDX-License-Identifier: Apache-2.0

config BOARD_WEACT_STM32G474_LONG
	select SOC_STM32G474XX
```

## board.yml
```yaml
board:
  name: weact_stm32g474_core
  vendor: weact
  socs:
    - name: stm32g474xx
```
